## CMakeLists.txt
```
# SPDX-License-Identifier: Apache-2.0
cmake_minimum_required(VERSION 3.20.0)

find_package(Zephyr REQUIRED HINTS $ENV{ZEPHYR_BASE})
project(vib_display_demo)

target_sources(app PRIVATE
    ${CMAKE_SOURCE_DIR}/src/main.c
    ${CMAKE_SOURCE_DIR}/src/logger.c
)

if(CONFIG_DISPLAY)
target_sources(app PRIVATE
    ${CMAKE_SOURCE_DIR}/src/lcd.c
)
endif()

include_directories(${CMAKE_SOURCE_DIR}/include)
```

## Kconfig
```
# Copyright (c) 2021 Laird Connectivity
# SPDX-License-Identifier: Apache-2.0

menu "Vibration Display Demo"

config APP_LCD_DATA_POINTS
    int "Number of data points to display on the graph"
    range 10 100
    default 10
    help
        Sets the number of data points for each line (X, Y and Z) to
        display on the graph. Note that more points will result in more
        time required to display the data. The time required to display
        the data increases as data changes, especially if the data is
        changing rapidly.

endmenu

source "Kconfig.zephyr"
```

## prj.conf
```kconfig
# Configure peripherals
CONFIG_I2C=y
CONFIG_SENSOR=y
CONFIG_LIS2DH=y
CONFIG_LIS2DH_TRIGGER_NONE=y
CONFIG_LIS2DH_ACCEL_RANGE_4G=y
CONFIG_LIS2DH_OPER_MODE_HIGH_RES=y
CONFIG_LIS2DH_ODR_6=y
#CONFIG_LCZ=y
#CONFIG_LCZ_LED=y

CONFIG_LOG=y

CONFIG_DISPLAY=y

CONFIG_LVGL=y
CONFIG_LV_USE_LABEL=y
CONFIG_LV_USE_BTN=y
CONFIG_LV_USE_CHART=y
CONFIG_LV_USE_CHECKBOX=y

CONFIG_HEAP_MEM_POOL_SIZE=65536
CONFIG_MAIN_STACK_SIZE=32768
CONFIG_PRIVILEGED_STACK_SIZE=8192
CONFIG_SYSTEM_WORKQUEUE_STACK_SIZE=4096
CONFIG_IDLE_STACK_SIZE=2048
CONFIG_ISR_STACK_SIZE=4096
CONFIG_KOBJECT_TEXT_AREA=2048
```

## boards/bl5340_dvk_cpuapp.conf
```kconfig
CONFIG_SPI=y
CONFIG_ILI9340=y
CONFIG_KSCAN_FT5336=y
CONFIG_KSCAN_FT5336_INTERRUPT=y
CONFIG_KSCAN_INIT_PRIORITY=70
CONFIG_KSCAN=y
CONFIG_DISPLAY=y

CONFIG_HEAP_MEM_POOL_SIZE=65536
CONFIG_MAIN_STACK_SIZE=32768
CONFIG_PRIVILEGED_STACK_SIZE=8192
CONFIG_SYSTEM_WORKQUEUE_STACK_SIZE=4096
CONFIG_IDLE_STACK_SIZE=2048
CONFIG_ISR_STACK_SIZE=4096
CONFIG_KOBJECT_TEXT_AREA=2048
CONFIG_LVGL=y
#CONFIG_LV_Z_USE_LABEL=y
#CONFIG_LV_Z_USE_CONT=y
#CONFIG_LV_Z_USE_BTN=y
#CONFIG_LV_Z_USE_CHART=y
#CONFIG_LV_Z_USE_CHECKBOX=y
#CONFIG_LV_Z_USE_THEME_MATERIAL=y
#CONFIG_LV_Z_USE_OBJ_REALIGN=y
#CONFIG_LV_Z_ANTIALIAS=y
#CONFIG_LV_Z_DISP_DEF_REFR_PERIOD=10
#CONFIG_LV_Z_EXT_CLICK_AREA_FULL=y
#CONFIG_LV_Z_CHART_AXIS_TICK_LABEL_MAX_LEN=32

CONFIG_LV_Z_POINTER_KSCAN=y
#CONFIG_LV_Z_POINTER_KSCAN_DEV_NAME="TOUCH"
CONFIG_LV_Z_POINTER_KSCAN_SWAP_XY=y
CONFIG_LV_Z_POINTER_KSCAN_INVERT_X=y
CONFIG_LV_Z_POINTER_KSCAN_INVERT_Y=y
CONFIG_LV_Z_POINTER_KSCAN_MSGQ_COUNT=10

#CONFIG_LV_Z_COLOR_DEPTH_16=y
CONFIG_LV_Z_BITS_PER_PIXEL=16
#CONFIG_LV_Z_COLOR_16_SWAP=y
#CONFIG_LV_Z_HOR_RES_MAX=480
#CONFIG_LV_Z_VER_RES_MAX=320
#CONFIG_LV_Z_DPI=130
```

## boards/bl5340pa_dvk_cpuapp.conf
```kconfig
CONFIG_SPI=y
CONFIG_ILI9340=y
CONFIG_KSCAN_FT5336=y
CONFIG_KSCAN_FT5336_INTERRUPT=y
CONFIG_KSCAN_INIT_PRIORITY=70
CONFIG_KSCAN=y
CONFIG_DISPLAY=y

CONFIG_HEAP_MEM_POOL_SIZE=65536
CONFIG_MAIN_STACK_SIZE=32768
CONFIG_PRIVILEGED_STACK_SIZE=8192
CONFIG_SYSTEM_WORKQUEUE_STACK_SIZE=4096
CONFIG_IDLE_STACK_SIZE=2048
CONFIG_ISR_STACK_SIZE=4096
CONFIG_KOBJECT_TEXT_AREA=2048
CONFIG_LVGL=y
CONFIG_LV_USE_LABEL=y
#CONFIG_LV_USE_CONT=y
CONFIG_LV_USE_BTN=y
CONFIG_LV_USE_CHART=y
CONFIG_LV_USE_CHECKBOX=y
#CONFIG_LV_USE_THEME_MATERIAL=y
#CONFIG_LV_USE_OBJ_REALIGN=y
#CONFIG_LV_ANTIALIAS=y
CONFIG_LV_DISP_DEF_REFR_PERIOD=10
#CONFIG_LV_EXT_CLICK_AREA_FULL=y
#CONFIG_LV_CHART_AXIS_TICK_LABEL_MAX_LEN=32

CONFIG_LV_Z_POINTER_KSCAN=y
CONFIG_LV_Z_POINTER_KSCAN_SWAP_XY=y
CONFIG_LV_Z_POINTER_KSCAN_INVERT_X=y
CONFIG_LV_Z_POINTER_KSCAN_INVERT_Y=y
CONFIG_LV_Z_POINTER_KSCAN_MSGQ_COUNT=10

CONFIG_LV_COLOR_DEPTH_16=y
CONFIG_LV_Z_BITS_PER_PIXEL=16
#CONFIG_LV_COLOR_16_SWAP=y
#CONFIG_LV_Z_HOR_RES_MAX=480
#CONFIG_LV_Z_VER_RES_MAX=320
#CONFIG_LV_Z_DPI=130
```

## src/main.c
```c
/**
 * @file main.c
 * @brief Main application file for vibration display demo application
 *
 * Copyright (c) 2021-2023 Laird Connectivity
 *
 * SPDX-License-Identifier: Apache-2.0
 */

/******************************************************************************/
/* Includes                                                                   */
/******************************************************************************/
#include "application.h"
#ifdef CONFIG_DISPLAY
#include "lcd.h"
#endif

/******************************************************************************/
/* Global Function Definitions                                                */
/******************************************************************************/
void main(void)
{
#ifdef CONFIG_DISPLAY
	SetupLCD();
#endif

	ApplicationStart();
}
```

## include/application.h
```c
/**
 * @file application.h
 * @brief Application function header file
 *
 * Copyright (c) 2021 Laird Connectivity
 *
 * SPDX-License-Identifier: Apache-2.0
 */
#ifndef __APPLICATION_H__
#define __APPLICATION_H__

#ifdef __cplusplus
extern "C" {
#endif

/******************************************************************************/
/* Includes                                                                   */
/******************************************************************************/
#include <zephyr/kernel.h>

/******************************************************************************/
/* Global Function Prototypes                                                 */
/******************************************************************************/
/**
 * @brief Starts the application (called from main)
 */
void ApplicationStart(void);

#ifdef __cplusplus
}
#endif

#endif /* __APPLICATION_H__ */
```

## include/lcd.h
```c
/**
 * @file lcd.h
 * @brief LCD display code for vibration display demo application
 *
 * Copyright (c) 2021 Laird Connectivity
 *
 * SPDX-License-Identifier: Apache-2.0
 */
#ifndef __LCD_H__
#define __LCD_H__

#ifdef __cplusplus
extern "C" {
#endif

/******************************************************************************/
/* Includes                                                                   */
/******************************************************************************/
#include <zephyr/kernel.h>

/******************************************************************************/
/* Global Constants, Macros and Type Definitions                              */
/******************************************************************************/
enum OBJECT_IDS {
	OBJECT_ID_STOP_BUTTON = 0,
	OBJECT_ID_START_BUTTON,
};

enum STATES {
	STATE_BUTTON_CLICKED = 0,
};

struct lcd_event_s {
	uint8_t object_id;
	bool state;
};

#define LCD_EVENT_MESSAGE_QUEUE_EVENTS 2
#define LCD_EVENT_MESSAGE_QUEUE_ALIGNMENT 4

/******************************************************************************/
/* Global Data Definitions                                                    */
/******************************************************************************/
extern struct k_msgq lcd_event_queue;

/******************************************************************************/
/* Global Function Prototypes                                                 */
/******************************************************************************/
/**
 * @brief Sets up the LCD for use
 */
void SetupLCD(void);

/**
 * @brief Checks if the sensor was detected or not
 *
 * @retval False if LCD is not present, true if it is
 */
bool IsLCDPresent(void);

/**
 * @brief Updates the current graph results
 *
 * @param X co-ordinate data in 0.001 g units
 * @param Y co-ordinate data in 0.001 g units
 * @param X co-ordinate data in 0.001 g units
 */
void UpdateLCDGraph(int16_t x, int16_t y, int16_t z);

#ifdef __cplusplus
}
#endif

#endif /* __LCD_H__ */
```

## src/lcd.c
```c
/**
 * @file lcd.c
 * @brief LCD display code for vibration display demo application
 *
 * Copyright (c) 2021 Laird Connectivity
 *
 * SPDX-License-Identifier: Apache-2.0
 */

/******************************************************************************/
/* Includes                                                                   */
/******************************************************************************/
#include <zephyr/logging/log.h>
LOG_MODULE_REGISTER(lcd, LOG_LEVEL_DBG);

#include <zephyr/drivers/display.h>

#include <lvgl.h>
#include "lcd.h"

/******************************************************************************/
/* Local Constant, Macro and Type Definitions                                 */
/******************************************************************************/
#define DISPLAY_INPUT_PERIOD_MS 25
#define CHART_WIDTH 220
#define CHART_HEIGHT 120
#define CHART_Y_PRIMARY_MIN -4000
#define CHART_Y_PRIMARY_MAX 4000
#define CHART_PADDING_TOP 10
#define CHART_PADDING_BOTTOM 28
#define CHART_PADDING_LEFT 45
#define CHART_PADDING_RIGHT 15
#define CONTAINER_PADDING 5
#define STARTSTOP_BUTTON_START_TEXT "Start"
#define STARTSTOP_BUTTON_STOP_TEXT "Stop"

/******************************************************************************/
/* Local Data Definitions                                                     */
/******************************************************************************/
static bool lcd_present = false;

static lv_obj_t *ui_chart;
static lv_chart_series_t *chart_series_x = NULL;
static lv_chart_series_t *chart_series_y = NULL;
static lv_chart_series_t *chart_series_z = NULL;


/******************************************************************************/
/* Local Function Prototypes                                                  */
/******************************************************************************/
static void lcd_display_update_handler(struct k_work *work);
static void lcd_display_update_timer_handler(struct k_timer *dummy);

K_WORK_DEFINE(lcd_display_update, lcd_display_update_handler);
K_TIMER_DEFINE(lcd_display_update_timer, lcd_display_update_timer_handler,
	       NULL);

/******************************************************************************/
/* Local Function Definitions                                                 */
/******************************************************************************/
static void lcd_display_update_handler(struct k_work *work)
{
	/* Triggers every 50ms for input handling */
	lv_task_handler();
}

static void lcd_display_update_timer_handler(struct k_timer *dummy)
{
	k_work_submit(&lcd_display_update);
}

/******************************************************************************/
/* Global Function Definitions                                                */
/******************************************************************************/
void SetupLCD(void)
{
	const struct device *const display_dev =
		DEVICE_DT_GET(DT_CHOSEN(zephyr_display));
	if (display_dev == NULL) {
		LOG_ERR("Display device %s was not found.", "DISPLAY");
		lcd_present = false;
		return;
	}
	if (!device_is_ready(display_dev)) {
		LOG_ERR("Device %s is not ready", display_dev->name);
		return;
	}
	lcd_present = true;

	ui_chart = lv_chart_create(lv_scr_act());
	lv_obj_center(ui_chart);
	
	lv_chart_set_range(ui_chart, LV_CHART_AXIS_PRIMARY_Y,
			     CHART_Y_PRIMARY_MIN, CHART_Y_PRIMARY_MAX);
	lv_chart_set_type(ui_chart, LV_CHART_TYPE_LINE);
	lv_chart_set_point_count(ui_chart, CONFIG_APP_LCD_DATA_POINTS);
	lv_chart_set_update_mode(ui_chart, LV_CHART_UPDATE_MODE_SHIFT);

	chart_series_x =
		lv_chart_add_series(ui_chart, lv_palette_main(LV_PALETTE_RED),
				    LV_CHART_AXIS_PRIMARY_X);

	chart_series_y = lv_chart_add_series(ui_chart,
					     lv_palette_main(LV_PALETTE_YELLOW),
					     LV_CHART_AXIS_PRIMARY_X);
	chart_series_z =
		lv_chart_add_series(ui_chart, lv_palette_main(LV_PALETTE_GREEN),
				    LV_CHART_AXIS_PRIMARY_X);

	display_blanking_off(display_dev);
	lv_task_handler();

	k_timer_start(&lcd_display_update_timer,
		      K_MSEC(DISPLAY_INPUT_PERIOD_MS),
		      K_MSEC(DISPLAY_INPUT_PERIOD_MS));
}

bool IsLCDPresent(void)
{
	return lcd_present;
}

void UpdateLCDGraph(int16_t x, int16_t y, int16_t z)
{
	/* Limit values to min and max graph values, this happens if there is a
	 * large amount of movement
	 */
	if (x > CHART_Y_PRIMARY_MAX) {
		x = CHART_Y_PRIMARY_MAX;
	} else if (x < CHART_Y_PRIMARY_MIN) {
		x = CHART_Y_PRIMARY_MIN;
	}

	if (y > CHART_Y_PRIMARY_MAX) {
		y = CHART_Y_PRIMARY_MAX;
	} else if (y < CHART_Y_PRIMARY_MIN) {
		y = CHART_Y_PRIMARY_MIN;
	}

	if (z > CHART_Y_PRIMARY_MAX) {
		z = CHART_Y_PRIMARY_MAX;
	} else if (z < CHART_Y_PRIMARY_MIN) {
		z = CHART_Y_PRIMARY_MIN;
	}

	lv_chart_set_next_value(ui_chart, chart_series_x, x);
	lv_chart_set_next_value(ui_chart, chart_series_y, y);
	lv_chart_set_next_value(ui_chart, chart_series_z, z);
}
```

## src/logger.c
```c
/**
 * @file logger.c
 * @brief Logging application file for vibration display demo application
 *
 * Copyright (c) 2021 Laird Connectivity
 *
 * SPDX-License-Identifier: Apache-2.0
 */

/******************************************************************************/
/* Includes                                                                   */
/******************************************************************************/
#include <zephyr/sys/printk.h>
#include <zephyr/kernel.h>
#include <zephyr/logging/log.h>
#include <zephyr/drivers/sensor.h>
#include <zephyr/drivers/gpio.h>
// #include <lcz_led.h>

#include "application.h"
#include "lcd.h"
// #include "../../../ble_gateway_firmware/app/common/include/led_configuration.h"

LOG_MODULE_REGISTER(logger);

/******************************************************************************/
/* Local Constant, Macro and Type Definitions                                 */
/******************************************************************************/
#define ACCEL_CHECK_TIMER_MS 30
#define ACCEL_VAL1_CONVERSION_FACTOR 100
#define ACCEL_VAL2_CONVERSION_FACTOR 10000
#define ACCEL_ARRAY_X 0
#define ACCEL_ARRAY_Y 1
#define ACCEL_ARRAY_Z 2
#define ACCEL_ARRAY_SIZE 3
#define RECENT_ARRAY_SIZE 10
#define RECENT_MOTION_MINIMUM 250
#define NEGATIVE_TO_POSITIVE_MULTIPLY -1

#define lcz_led_turn_on(...)
#define lcz_led_turn_off(...)

/******************************************************************************/
/* Local Function Prototypes                                                  */
/******************************************************************************/
static void configure_leds(void);
static void vib_log_update_handler(struct k_work *work);
static void vib_log_update_handler(struct k_work *work);
static void vib_log_update_timer_handler(struct k_timer *dummy);

/******************************************************************************/
/* Local Data Definitions                                                     */
/******************************************************************************/
int16_t recent_x_values[RECENT_ARRAY_SIZE];
int16_t recent_y_values[RECENT_ARRAY_SIZE];
int16_t recent_z_values[RECENT_ARRAY_SIZE];
uint8_t recent_pos = 0;

K_WORK_DEFINE(vib_log_update, vib_log_update_handler);
K_TIMER_DEFINE(vib_log_update_timer, vib_log_update_timer_handler, NULL);

/******************************************************************************/
/* Global Function Definitions                                                */
/******************************************************************************/
void ApplicationStart(void)
{
	/* Setup LEDs for motion output */
	configure_leds();

	k_timer_start(&vib_log_update_timer, K_MSEC(ACCEL_CHECK_TIMER_MS),
		      K_MSEC(ACCEL_CHECK_TIMER_MS));
}

static void vib_log_update_handler(struct k_work *work)
{
	int rc;
	struct sensor_value accel[ACCEL_ARRAY_SIZE];

	const struct device *const sensor = DEVICE_DT_GET_ANY(st_lis2dh);
	if (sensor == NULL) {
		printk("Could not get find accelerometer\n");
		return;
	}
	if (!device_is_ready(sensor)) {
		printk("Device %s is not ready\n", sensor->name);
		return;
	}

	rc = sensor_sample_fetch(sensor);

	if (rc == 0 || rc == -EBADMSG) {
		rc = sensor_channel_get(sensor, SENSOR_CHAN_ACCEL_XYZ, accel);

		if (rc == 0) {
			/* Readings returned by the sensor driver are in 10ths
			 * of a g, convert to 0.001 units
			 */
			int16_t x = (accel[ACCEL_ARRAY_X].val1 * ACCEL_VAL1_CONVERSION_FACTOR) +
				    (accel[ACCEL_ARRAY_X].val2 / ACCEL_VAL2_CONVERSION_FACTOR);
			int16_t y = (accel[ACCEL_ARRAY_Y].val1 * ACCEL_VAL1_CONVERSION_FACTOR) +
				    (accel[ACCEL_ARRAY_Y].val2 / ACCEL_VAL2_CONVERSION_FACTOR);
			int16_t z = (accel[ACCEL_ARRAY_Z].val1 * ACCEL_VAL1_CONVERSION_FACTOR) +
				    (accel[ACCEL_ARRAY_Z].val2 / ACCEL_VAL2_CONVERSION_FACTOR);

			UpdateLCDGraph(x, y, z);

			/* Record recent positions for motion alert */
			recent_x_values[recent_pos] = x;
			recent_y_values[recent_pos] = y;
			recent_z_values[recent_pos] = z;
			++recent_pos;

			if (recent_pos >= RECENT_ARRAY_SIZE) {
				recent_pos = 0;
			}

			/* X-axis motion checking */
			uint8_t i = 0;
			int32_t tmp = 0;
			while (i < RECENT_ARRAY_SIZE) {
				tmp += (int32_t)recent_x_values[i];
				++i;
			}
			tmp /= RECENT_ARRAY_SIZE;

			int32_t motion_amount = (int32_t)x - tmp;
			if (motion_amount < 0) {
				motion_amount *= NEGATIVE_TO_POSITIVE_MULTIPLY;
			}

			if (motion_amount > RECENT_MOTION_MINIMUM) {
				lcz_led_turn_on(BLUE_LED1);
			} else {
				lcz_led_turn_off(BLUE_LED1);
			}

			/* Y-axis motion checking */
			i = 0;
			tmp = 0;
			while (i < RECENT_ARRAY_SIZE) {
				tmp += (int32_t)recent_y_values[i];
				++i;
			}
			tmp /= RECENT_ARRAY_SIZE;

			motion_amount = (int32_t)y - tmp;
			if (motion_amount < 0) {
				motion_amount *= NEGATIVE_TO_POSITIVE_MULTIPLY;
			}

			if (motion_amount > RECENT_MOTION_MINIMUM) {
				lcz_led_turn_on(BLUE_LED2);
			} else {
				lcz_led_turn_off(BLUE_LED2);
			}

			/* Z-axis motion checking */
			i = 0;
			tmp = 0;
			while (i < RECENT_ARRAY_SIZE) {
				tmp += (int32_t)recent_z_values[i];
				++i;
			}
			tmp /= RECENT_ARRAY_SIZE;

			motion_amount = (int32_t)z - tmp;
			if (motion_amount < 0) {
				motion_amount *= NEGATIVE_TO_POSITIVE_MULTIPLY;
			}

			if (motion_amount > RECENT_MOTION_MINIMUM) {
				lcz_led_turn_on(BLUE_LED3);
			} else {
				lcz_led_turn_off(BLUE_LED3);
			}
		}
	}
}

static void vib_log_update_timer_handler(struct k_timer *dummy)
{
	k_work_submit(&vib_log_update);
}

static void configure_leds(void)
{
#if 0
#if defined(CONFIG_BOARD_BL5340_DVK_CPUAPP)
	struct lcz_led_configuration c[] = {
		{ BLUE_LED1, LED1_DEV, LED1, LED_ACTIVE_LOW },
		{ BLUE_LED2, LED2_DEV, LED2, LED_ACTIVE_LOW },
		{ BLUE_LED3, LED3_DEV, LED3, LED_ACTIVE_LOW },
		{ BLUE_LED4, LED4_DEV, LED4, LED_ACTIVE_LOW }
	};
#else
#error "Unsupported board selected"
#endif
	lcz_led_init(c, ARRAY_SIZE(c));
#endif
}
```
