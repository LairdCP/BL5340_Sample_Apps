## CMakeLists.txt
```
# SPDX-License-Identifier: Apache-2.0
cmake_minimum_required(VERSION 3.13.1)

find_package(Zephyr REQUIRED HINTS $ENV{ZEPHYR_BASE})
project(ess_demo)

target_sources(app PRIVATE
    ${CMAKE_SOURCE_DIR}/src/main.c
    ${CMAKE_SOURCE_DIR}/src/sensor.c
    ${CMAKE_SOURCE_DIR}/src/dewpoint.c
)

if(CONFIG_DISPLAY)
target_sources(app PRIVATE
    ${CMAKE_SOURCE_DIR}/src/lcd.c
)
endif()

include_directories(${CMAKE_SOURCE_DIR}/include)
```

## prj.conf
```kconfig
# Configure peripherals
CONFIG_I2C=y
CONFIG_FPU=y

# Configure modules
CONFIG_TINYCRYPT=y
CONFIG_NEWLIB_LIBC=y
CONFIG_NEWLIB_LIBC_FLOAT_PRINTF=y

# Configure Bluetooth
CONFIG_BT=y
CONFIG_BT_PERIPHERAL=y
CONFIG_BT_SMP=y
CONFIG_BT_DEVICE_NAME="BL654 BME280 Sensor"
CONFIG_BT_DEVICE_APPEARANCE=1362
CONFIG_BT_CONN_TX_MAX=4
CONFIG_BT_L2CAP_TX_BUF_COUNT=4
CONFIG_BT_GATT_DYNAMIC_DB=y
CONFIG_BT_PERIPHERAL_PREF_MIN_INT=80
CONFIG_BT_PERIPHERAL_PREF_MAX_INT=160
CONFIG_BT_PERIPHERAL_PREF_SLAVE_LATENCY=2
CONFIG_BT_PERIPHERAL_PREF_TIMEOUT=400

# Configure Laird Connectivity components
CONFIG_LCZ=y
CONFIG_LCZ_BT=y
CONFIG_LCZ_BLE_DIS=y
CONFIG_BLE_ESS_SERVICE=y
```

## boards/bl5340_dvk_cpuapp.conf
```kconfig
CONFIG_SENSOR=y
CONFIG_BME680=y
CONFIG_SPI=y
CONFIG_ILI9340=y
CONFIG_KSCAN_FT5336=y
CONFIG_KSCAN_FT5336_INTERRUPT=y
CONFIG_KSCAN_INIT_PRIORITY=70
CONFIG_KSCAN=y
CONFIG_DISPLAY=y

CONFIG_HEAP_MEM_POOL_SIZE=32768
CONFIG_MAIN_STACK_SIZE=16384
CONFIG_PRIVILEGED_STACK_SIZE=4096
CONFIG_SYSTEM_WORKQUEUE_STACK_SIZE=2048
CONFIG_IDLE_STACK_SIZE=1024
CONFIG_ISR_STACK_SIZE=2048
CONFIG_KOBJECT_TEXT_AREA=1024
CONFIG_LVGL=y
CONFIG_LVGL_USE_LABEL=y
CONFIG_LVGL_USE_CONT=y
CONFIG_LVGL_USE_BTN=y
CONFIG_LVGL_USE_CHART=y
CONFIG_LVGL_USE_CHECKBOX=y
CONFIG_LVGL_USE_THEME_MATERIAL=y
CONFIG_LVGL_USE_OBJ_REALIGN=y
CONFIG_LVGL_ANTIALIAS=y
CONFIG_LVGL_DISP_DEF_REFR_PERIOD=10
CONFIG_LVGL_EXT_CLICK_AREA_FULL=y
CONFIG_LVGL_CHART_AXIS_TICK_LABEL_MAX_LEN=32

CONFIG_LVGL_POINTER_KSCAN=y
CONFIG_LVGL_POINTER_KSCAN_DEV_NAME="TOUCH"
CONFIG_LVGL_POINTER_KSCAN_SWAP_XY=y
CONFIG_LVGL_POINTER_KSCAN_INVERT_X=y
CONFIG_LVGL_POINTER_KSCAN_INVERT_Y=y
CONFIG_LVGL_POINTER_KSCAN_MSGQ_COUNT=10

CONFIG_LVGL_COLOR_DEPTH_16=y
CONFIG_LVGL_BITS_PER_PIXEL=16
CONFIG_LVGL_COLOR_16_SWAP=y
CONFIG_LVGL_HOR_RES_MAX=480
CONFIG_LVGL_VER_RES_MAX=320
CONFIG_LVGL_DPI=130
```

## boards/bl654_sensor_board.conf
```kconfig
CONFIG_SENSOR=y
CONFIG_BME280=y
CONFIG_SERIAL=n
CONFIG_CONSOLE=n
CONFIG_BT_BONDABLE=n
CONFIG_BT_CTLR_TX_PWR_PLUS_4=y
CONFIG_PRINTK=n
CONFIG_EARLY_CONSOLE=n
CONFIG_ASSERT_VERBOSE=n
CONFIG_SPEED_OPTIMIZATIONS=y
CONFIG_BOOT_BANNER=n
```

## src/main.c
```c
/**
 * @file main.c
 * @brief Main application file for ESS service sample application
 *
 * Copyright (c) 2021 Laird Connectivity
 *
 * SPDX-License-Identifier: Apache-2.0
 */

/******************************************************************************/
/* Includes                                                                   */
/******************************************************************************/
#include <stdbool.h>
#include <zephyr/types.h>
#include <stddef.h>
#include <string.h>
#include <errno.h>
#include <random/rand32.h>
#include <sys/printk.h>
#include <sys/byteorder.h>
#include <zephyr.h>
#include <logging/log.h>
#include <bluetooth/bluetooth.h>
#include <bluetooth/hci.h>
#include <bluetooth/conn.h>
#include <bluetooth/uuid.h>
#include <bluetooth/gatt.h>
#include <bluetooth/services/bas.h>
#include <ble_ess_service.h>
#ifdef CONFIG_LCZ_BLE_DIS
#include <dis.h>
#endif

#include "app_version.h"
#include "sensor.h"
#include "dewpoint.h"
#ifdef CONFIG_DISPLAY
#include "lcd.h"
#endif

LOG_MODULE_REGISTER(main);

/******************************************************************************/
/* Local Data Definitions                                                     */
/******************************************************************************/
#define ESS_SERVICE_START_TIMER_S 2
#define ESS_SERVICE_UPDATE_TIMER_S 10

#define ADVERTISING_INTERVAL_MIN 320 /* in 0.625ms units */
#define ADVERTISING_INTERVAL_MAX 800 /* in 0.625ms units */

static void ess_svc_update_handler(struct k_work *work);
static void ess_svc_update_timer_handler(struct k_timer *dummy);

K_WORK_DEFINE(ess_svc_update, ess_svc_update_handler);
K_TIMER_DEFINE(ess_svc_update_timer, ess_svc_update_timer_handler, NULL);

/******************************************************************************/
/* Local Function Prototypes                                                  */
/******************************************************************************/
static void connected(struct bt_conn *conn, uint8_t err);
static void disconnected(struct bt_conn *conn, uint8_t reason);
static void bt_ready(void);
static void ess_svc_update_handler(struct k_work *work);

/******************************************************************************/
/* Local Function Definitions                                                 */
/******************************************************************************/
static void connected(struct bt_conn *conn, uint8_t err)
{
	if (err) {
		LOG_ERR("Connection failed (err 0x%02x)\n", err);
	} else {
		LOG_INF("Connected\n");
	}

#ifdef CONFIG_DISPLAY
	struct bt_conn_info ble_info;

	bt_conn_get_info(conn, &ble_info);
	update_lcd_connected_address(true, ble_info.le.dst->type,
				     ble_info.le.dst->a.val);
#else
	k_timer_start(&ess_svc_update_timer,
		      K_SECONDS(ESS_SERVICE_UPDATE_TIMER_S),
		      K_SECONDS(ESS_SERVICE_UPDATE_TIMER_S));
	ess_svc_update_handler(NULL);
#endif
}

static void disconnected(struct bt_conn *conn, uint8_t reason)
{
	LOG_INF("Disconnected (reason 0x%02x)\n", reason);

#ifdef CONFIG_DISPLAY
	update_lcd_connected_address(false, 0, NULL);
#else
	k_timer_stop(&ess_svc_update_timer);
#endif
}

static struct bt_conn_cb conn_callbacks = {
	.connected = connected,
	.disconnected = disconnected,
};

static const struct bt_data ad[] = {
	BT_DATA_BYTES(BT_DATA_FLAGS, (BT_LE_AD_GENERAL | BT_LE_AD_NO_BREDR)),
	BT_DATA_BYTES(BT_DATA_UUID16_ALL, BT_UUID_16_ENCODE(BT_UUID_ESS_VAL))
};

static void bt_ready(void)
{
	int err;

	LOG_INF("Bluetooth initialized\n");

	err = bt_le_adv_start(BT_LE_ADV_PARAM((BT_LE_ADV_OPT_CONNECTABLE |
					       BT_LE_ADV_OPT_USE_NAME |
					       BT_LE_ADV_OPT_FORCE_NAME_IN_AD),
					      ADVERTISING_INTERVAL_MIN,
					      ADVERTISING_INTERVAL_MAX, NULL),
			      ad, ARRAY_SIZE(ad), NULL, 0);
	if (err) {
		LOG_ERR("Advertising failed to start (err %d)\n", err);
		return;
	}

	LOG_INF("Advertising successfully started\n");
}

static void ess_svc_update_handler(struct k_work *work)
{
	int8_t dew_point;
	float temperature, humidity;

	read_sensor();

	read_temperature_float(&temperature);
	read_humidity_float(&humidity);
	dew_point = calculate_dew_point(temperature, humidity);

	ess_svc_update_temperature(NULL, read_temperature());
	ess_svc_update_humidity(NULL, read_humidity());
	ess_svc_update_pressure(NULL, read_pressure());
	ess_svc_update_dew_point(NULL, dew_point);

#ifdef CONFIG_DISPLAY
	float pressure;
	read_pressure_float(&pressure);
	update_lcd_graph(temperature, humidity, pressure, (float)dew_point);
#endif
}

static void ess_svc_update_timer_handler(struct k_timer *dummy)
{
	k_work_submit(&ess_svc_update);
}

/******************************************************************************/
/* Global Function Definitions                                                */
/******************************************************************************/
void main(void)
{
	int err;

	setup_sensor();
	if (!is_sensor_present()) {
		LOG_ERR("Sensor not detected, application cannot start");
#ifdef CONFIG_DISPLAY
		setup_lcd(true, "Sensor not detected");
#endif
		return;
	}

	err = bt_enable(NULL);
	if (err) {
		LOG_ERR("Bluetooth init failed (err %d)\n", err);
#ifdef CONFIG_DISPLAY
		setup_lcd(true, "Bluetooth init failed");
#endif
		return;
	}

	bt_ready();

	bt_conn_cb_register(&conn_callbacks);

#ifdef CONFIG_LCZ_BLE_DIS
	dis_initialize(APP_VERSION_STRING);
#endif

	ess_svc_init();

#ifdef CONFIG_DISPLAY
	setup_lcd(false, NULL);

	k_timer_start(&ess_svc_update_timer,
		      K_SECONDS(ESS_SERVICE_START_TIMER_S),
		      K_SECONDS(ESS_SERVICE_UPDATE_TIMER_S));

	read_sensor();
#endif
}
```

## include/app_version.h
```c
/**
 * @file app_version.h
 * @brief Version of the application
 *
 * Copyright (c) 2021 Laird Connectivity
 *
 * SPDX-License-Identifier: Apache-2.0
 */
#ifndef __APP_VERSION_H__
#define __APP_VERSION_H__

#ifdef __cplusplus
extern "C" {
#endif

/******************************************************************************/
/* Application Firmware Version                                               */
/******************************************************************************/
#define APP_VERSION_MAJOR 1
#define APP_VERSION_MINOR 0
#define APP_VERSION_PATCH 0
#define APP_VERSION_STRING                                                     \
	STRINGIFY(APP_VERSION_MAJOR)                                           \
	"." STRINGIFY(APP_VERSION_MINOR) "." STRINGIFY(APP_VERSION_PATCH)

#ifdef __cplusplus
}
#endif

#endif /* __APP_VERSION_H__ */
```

## include/dewpoint.h
```c
/**
 * @file dewpoint.h
 * @brief Allows calculating dew point from a given temperature and humidity
 *
 * Copyright (c) 2009 Sensirion
 */
#ifndef __DEWPOINT_H__
#define __DEWPOINT_H__

#ifdef __cplusplus
extern "C" {
#endif

/******************************************************************************/
/* Includes                                                                   */
/******************************************************************************/
#include <zephyr.h>

/******************************************************************************/
/* Global Function Prototypes                                                 */
/******************************************************************************/
/**
 * @brief Calculates the dew point of a given temperature and humidity
 *
 * @note The formula for calculating the dew point was adapted from
 * http://irtfweb.ifa.hawaii.edu/~tcs3/tcs3/Misc/Dewpoint_Calculation_Humidity_Sensor_E.pdf
 *
 * @param Temperature in degrees celsius (C)
 * @param Humidity in percent (%)
 *
 * @retval Dew point in celsius
 */
int8_t calculate_dew_point(float temperature, float humidity);

#ifdef __cplusplus
}
#endif

#endif /* __DEWPOINT_H__ */
```

## include/lcd.h
```c
/**
 * @file lcd.h
 * @brief LCD display code for sensor data
 *
 * Copyright (c) 2021 Laird Connectivity
 *
 * SPDX-License-Identifier: Apache-2.0
 */
#ifndef __LCD_H__
#define __LCD_H__

#ifdef __cplusplus
extern "C" {
#endif

/******************************************************************************/
/* Includes                                                                   */
/******************************************************************************/
#include <zephyr.h>
#include <device.h>
#include <drivers/sensor.h>
#include <stdio.h>
#include <sys/byteorder.h>
#include <drivers/display.h>
#include <lvgl.h>

#ifdef CONFIG_DISPLAY

/******************************************************************************/
/* Global Function Prototypes                                                 */
/******************************************************************************/
/**
 * @brief Sets up the LCD for use
 *
 * @param True if the application has failed to initialise
 * @param String containing the error to display if in an error state
 */
void setup_lcd(bool error, char *error_string);

/**
 * @brief Checks if the sensor was detected or not
 *
 * @retval False if LCD is not present, true if it is
 */
bool is_lcd_present(void);

/**
 * @brief Updates the current graph results
 *
 * @param Temperature in degrees celsius (C)
 * @param Humidity in percent (%)
 * @param Pressure in pascals (pa)
 * @param Dew point in degrees celsius (C)
 */
void update_lcd_graph(float temperature, float humidity, float pressure,
		      float dew_point);

/**
 * @brief Updates the display with the connected device's address (if connected)
 *
 * @param True if connected, otherwise false
 * @param Type of the address
 * @param BLE address byte array
 */
void update_lcd_connected_address(bool connected, uint8_t type,
				  const uint8_t *address);

/**
 * @brief Updates the LCD display text
 */
void update_lcd_text(void);

#endif

#ifdef __cplusplus
}
#endif

#endif /* __LCD_H__ */
```

## include/sensor.h
```c
/**
 * @file sensor.h
 * @brief Handles dealing with and formatting data from the BME680 sensor
 *
 * Copyright (c) 2021 Laird Connectivity
 *
 * SPDX-License-Identifier: Apache-2.0
 */
#ifndef __SENSOR_H__
#define __SENSOR_H__

#ifdef __cplusplus
extern "C" {
#endif

/******************************************************************************/
/* Includes                                                                   */
/******************************************************************************/
#include <zephyr.h>
#include <device.h>
#include <drivers/sensor.h>
#include <stdio.h>
#include <sys/byteorder.h>

/******************************************************************************/
/* Global Function Prototypes                                                 */
/******************************************************************************/
/**
 * @brief Sets up the sensor
 */
void setup_sensor(void);

/**
 * @brief Checks if the sensor was detected or not
 *
 * @retval False if sensor is not present, true if it is
 */
bool is_sensor_present(void);

/**
 * @brief Reads the data from the sensor and stores readings internally
 */
void read_sensor(void);

/**
 * @brief Reads the latest temperature sensor reading
 *
 * @retval Temperature in degrees celsius (C) in 0.01 units
 */
int16_t read_temperature(void);

/**
 * @brief Reads the latest humidity sensor reading
 *
 * @retval Humidity in percent (%) in 0.01 units
 */
int16_t read_humidity(void);

/**
 * @brief Reads the latest pressure sensor reading
 *
 * @retval Pressure in pascals (pa) in 0.1 units
 */
int32_t read_pressure(void);

/**
 * @brief Reads the latest temperature sensor reading
 *
 * @param Temperature in degrees celsius (C)
 */
void read_temperature_float(float *temperature);

/**
 * @brief Reads the latest humidity sensor reading
 *
 * @param Humidity in percent (%)
 */
void read_humidity_float(float *humidity);

/**
 * @brief Reads the latest pressure sensor reading
 *
 * @param Pressure in pascals (Pa)
 */
void read_pressure_float(float *pressure);

#ifdef __cplusplus
}
#endif

#endif /* __SENSOR_H__ */
```

## src/dewpoint.c
```c
/**
 * @file dewpoint.c
 * @brief Allows calculating dew point from a given temperature and humidity
 *
 * Copyright (c) 2009 Sensirion
 */

/******************************************************************************/
/* Includes                                                                   */
/******************************************************************************/
#include <math.h>
#include "dewpoint.h"
#include "sensor.h"

/******************************************************************************/
/* Global Function Definitions                                                */
/******************************************************************************/
int8_t calculate_dew_point(float fTemp, float fHum)
{
	float hTmp =
		(log10(fHum) - 2) / 0.4343 + (17.62 * fTemp) / (243.12 + fTemp);
	hTmp = 243.12 * hTmp / (17.62 - hTmp);

	return (int8_t)hTmp;
}
```

## src/lcd.c
```c
/**
 * @file lcd.c
 * @brief LCD display code for sensor data
 *
 * Copyright (c) 2021 Laird Connectivity
 *
 * SPDX-License-Identifier: Apache-2.0
 */

/******************************************************************************/
/* Includes                                                                   */
/******************************************************************************/
#include <logging/log.h>
#include <drivers/display.h>
#include <bluetooth/bluetooth.h>
#include <bluetooth/hci.h>
#include <bluetooth/conn.h>
#include <bluetooth/uuid.h>
#include <bluetooth/gatt.h>
#include <bluetooth/services/bas.h>
#include <bluetooth/addr.h>

#include "lcd.h"

#ifdef CONFIG_DISPLAY

LOG_MODULE_REGISTER(lcd);

/******************************************************************************/
/* Local Constant, Macro and Type Definitions                                 */
/******************************************************************************/
#define CHART_NUMBER_OF_POINTS 7
#define CONNECTION_STRING_MAX_SIZE 96
#define DISPLAY_INPUT_PERIOD_MS 10
#define DISPLAY_SCREEN_UPDATE_PERIOD_MS 1000
#define BLE_ADDRESS_COUNT 1
#define MS_PER_SECOND 1000
#define ESS_DISPLAY_UPDATE_TIMER_S 1
#define CHART_WIDTH 220
#define CHART_HEIGHT 120
#define CHART_Y_PRIMARY_MIN -20
#define CHART_Y_PRIMARY_MAX 100
#define CHART_Y_SECONDARY_MIN 960
#define CHART_Y_SECONDARY_MAX 1060
#define CHART_PADDING_TOP 10
#define CHART_PADDING_BOTTOM 28
#define CHART_PADDING_LEFT 50
#define CHART_PADDING_RIGHT 56
#define CONTAINER_PADDING 5
#define PRESSURE_TO_Y_AXIS_DIVISION 100.0
#define PRESSURE_TO_Y_AXIS_SUBTRACTION 980.0
#define BLE_ADDRESS_OUTPUT_A 5
#define BLE_ADDRESS_OUTPUT_B 4
#define BLE_ADDRESS_OUTPUT_C 3
#define BLE_ADDRESS_OUTPUT_D 2
#define BLE_ADDRESS_OUTPUT_E 1
#define BLE_ADDRESS_OUTPUT_F 0

/******************************************************************************/
/* Local Data Definitions                                                     */
/******************************************************************************/
static bool lcd_present = false;

static lv_obj_t *ui_chart;
static lv_chart_series_t *chart_series_temperature;
static lv_chart_series_t *chart_series_humidity;
static lv_chart_series_t *chart_series_pressure;
static lv_chart_series_t *chart_series_dew_point;
static lv_obj_t *ui_container_main;
static lv_obj_t *ui_container_graph;
static lv_obj_t *ui_container_selections;
static lv_obj_t *ui_check_temperature;
static lv_obj_t *ui_check_humidity;
static lv_obj_t *ui_check_pressure;
static lv_obj_t *ui_check_dew_point;
static lv_obj_t *ui_button_clear;
static lv_obj_t *ui_text_clear;
static lv_obj_t *ui_text_status;

static char display_string_buffer[CONNECTION_STRING_MAX_SIZE];

static int16_t chart_data_buffer_temperature[CHART_NUMBER_OF_POINTS];
static int16_t chart_data_buffer_humidity[CHART_NUMBER_OF_POINTS];
static int16_t chart_data_buffer_pressure[CHART_NUMBER_OF_POINTS];
static int16_t chart_data_buffer_dew_point[CHART_NUMBER_OF_POINTS];
static uint8_t chart_readings = 0;

static bool remote_device_connected = false;
static uint8_t remote_device_type;
static uint8_t remote_device_address[sizeof(bt_addr_t)];

static uint16_t display_update_count = 0;

/******************************************************************************/
/* Local Function Prototypes                                                  */
/******************************************************************************/
static void checkbox_event_handler(lv_obj_t *obj, lv_event_t event);
static void button_event_handler(lv_obj_t *obj, lv_event_t event);
static void ess_lcd_display_update_handler(struct k_work *work);
static void ess_lcd_display_update_timer_handler(struct k_timer *dummy);

K_WORK_DEFINE(ess_lcd_display_update, ess_lcd_display_update_handler);
K_TIMER_DEFINE(ess_lcd_display_update_timer,
	       ess_lcd_display_update_timer_handler, NULL);

/******************************************************************************/
/* Local Function Definitions                                                 */
/******************************************************************************/
static void checkbox_event_handler(lv_obj_t *obj, lv_event_t event)
{
	/* Only process events where a checkbox has been ticked or unticked */
	if (event == LV_EVENT_VALUE_CHANGED) {
		lv_chart_series_t *series = NULL;
		int16_t *chart_data = NULL;

		if (obj == ui_check_temperature) {
			series = chart_series_temperature;
			chart_data = chart_data_buffer_temperature;
		} else if (obj == ui_check_humidity) {
			series = chart_series_humidity;
			chart_data = chart_data_buffer_humidity;
		} else if (obj == ui_check_pressure) {
			series = chart_series_pressure;
			chart_data = chart_data_buffer_pressure;
		} else if (obj == ui_check_dew_point) {
			series = chart_series_dew_point;
			chart_data = chart_data_buffer_dew_point;
		}

		if (series != NULL) {
			if (lv_checkbox_is_checked(obj)) {
				/* Checkbox was ticked, add the data to the
				 * graph
				 */
				uint8_t i =
					CHART_NUMBER_OF_POINTS - chart_readings;
				while (i < CHART_NUMBER_OF_POINTS) {
					lv_chart_set_next(ui_chart, series,
							  chart_data[i]);
					++i;
				}
			} else {
				/* Checkbox was unticked, clear the series
				 * data
				 */
				lv_chart_clear_series(ui_chart, series);
			}

			lv_chart_refresh(ui_chart);
		}
	}
}

static void button_event_handler(lv_obj_t *obj, lv_event_t event)
{
	/* Only process events where a button has been pressed */
	if (event == LV_EVENT_CLICKED) {
		/* Clear all the buffered data and remove the data from the
		 * graph
		 */
		memset(chart_data_buffer_temperature, 0,
		       CHART_NUMBER_OF_POINTS);
		memset(chart_data_buffer_humidity, 0, CHART_NUMBER_OF_POINTS);
		memset(chart_data_buffer_pressure, 0, CHART_NUMBER_OF_POINTS);
		memset(chart_data_buffer_dew_point, 0, CHART_NUMBER_OF_POINTS);
		chart_readings = 0;

		lv_chart_clear_series(ui_chart, chart_series_temperature);
		lv_chart_clear_series(ui_chart, chart_series_humidity);
		lv_chart_clear_series(ui_chart, chart_series_pressure);
		lv_chart_clear_series(ui_chart, chart_series_dew_point);

		lv_chart_refresh(ui_chart);
	}
}

static void ess_lcd_display_update_handler(struct k_work *work)
{
	/* Triggers every 10ms to handle display updating and input handling */
	++display_update_count;

	if (display_update_count >=
	    (DISPLAY_SCREEN_UPDATE_PERIOD_MS / DISPLAY_INPUT_PERIOD_MS)) {
		/* Only update text roughly once a second */
		update_lcd_text();
		display_update_count = 0;
	}

	lv_task_handler();
}

static void ess_lcd_display_update_timer_handler(struct k_timer *dummy)
{
	k_work_submit(&ess_lcd_display_update);
}

/******************************************************************************/
/* Global Function Definitions                                                */
/******************************************************************************/
void setup_lcd(bool error, char *error_string)
{
	const struct device *display_dev;

	display_dev = device_get_binding(CONFIG_LVGL_DISPLAY_DEV_NAME);

	if (display_dev == NULL) {
		LOG_ERR("Display device %s was not found.",
			CONFIG_LVGL_DISPLAY_DEV_NAME);
		lcd_present = false;
		return;
	}
	lcd_present = true;

	if (error) {
		/* Error display handler, create a minimal display environment
		 * where the error message can be output, display the error and
		 * return without creating the normal environment
		 */
		sprintf(display_string_buffer,
			"Error occured during initialisation\n%s",
			(error_string == NULL ? "" : error_string));

		ui_container_main = lv_cont_create(lv_scr_act(), NULL);
		lv_obj_set_auto_realign(ui_container_main, true);
		lv_cont_set_fit(ui_container_main, LV_FIT_TIGHT);
		lv_cont_set_layout(ui_container_main, LV_LAYOUT_COLUMN_MID);

		ui_text_status = lv_label_create(ui_container_main, NULL);

		lv_label_set_text(ui_text_status, display_string_buffer);
		lv_obj_align(ui_text_status, NULL, LV_ALIGN_CENTER, 0, 0);

		display_blanking_off(display_dev);
		lv_task_handler();

		return;
	}

	/* Reset buffered data */
	memset(chart_data_buffer_temperature, 0, CHART_NUMBER_OF_POINTS);
	memset(chart_data_buffer_humidity, 0, CHART_NUMBER_OF_POINTS);
	memset(chart_data_buffer_pressure, 0, CHART_NUMBER_OF_POINTS);
	memset(chart_data_buffer_dew_point, 0, CHART_NUMBER_OF_POINTS);

	/* Create all the UI objects and set the style information. Containers
	 * are used to group objects and position them correctly. The main UI
	 * has a container into which all the objects are placed, there is a
	 * sub-container at the top for holding the graph and the graph series
	 * checkboxes (which are grouped into another sub-container). Beneath
	 * the graph is the clear button and a label containing information on
	 * the application. All objects are aligned to their centres
	 */
	ui_container_main = lv_cont_create(lv_scr_act(), NULL);
	lv_obj_set_auto_realign(ui_container_main, true);
	lv_cont_set_fit(ui_container_main, LV_FIT_TIGHT);
	lv_cont_set_layout(ui_container_main, LV_LAYOUT_COLUMN_MID);

	ui_container_graph = lv_cont_create(ui_container_main, NULL);
	lv_obj_set_auto_realign(ui_container_graph, true);
	lv_cont_set_fit(ui_container_graph, LV_FIT_TIGHT);
	lv_cont_set_layout(ui_container_graph, LV_LAYOUT_ROW_MID);

	lv_obj_set_style_local_pad_top(ui_container_graph, LV_OBJ_PART_MAIN,
				       LV_STATE_DEFAULT, CONTAINER_PADDING);
	lv_obj_set_style_local_pad_bottom(ui_container_graph, LV_OBJ_PART_MAIN,
					  LV_STATE_DEFAULT, CONTAINER_PADDING);
	lv_obj_set_style_local_pad_left(ui_container_graph, LV_OBJ_PART_MAIN,
					LV_STATE_DEFAULT, CONTAINER_PADDING);
	lv_obj_set_style_local_pad_right(ui_container_graph, LV_OBJ_PART_MAIN,
					 LV_STATE_DEFAULT, CONTAINER_PADDING);

	ui_chart = lv_chart_create(ui_container_graph, NULL);

	ui_container_selections = lv_cont_create(ui_container_graph, NULL);
	lv_obj_set_auto_realign(ui_container_selections, true);
	lv_cont_set_fit(ui_container_selections, LV_FIT_TIGHT);
	lv_cont_set_layout(ui_container_selections, LV_LAYOUT_COLUMN_LEFT);

	lv_obj_set_style_local_pad_top(ui_container_selections,
				       LV_OBJ_PART_MAIN, LV_STATE_DEFAULT,
				       CONTAINER_PADDING);
	lv_obj_set_style_local_pad_bottom(ui_container_selections,
					  LV_OBJ_PART_MAIN, LV_STATE_DEFAULT,
					  CONTAINER_PADDING);
	lv_obj_set_style_local_pad_left(ui_container_selections,
					LV_OBJ_PART_MAIN, LV_STATE_DEFAULT,
					CONTAINER_PADDING);
	lv_obj_set_style_local_pad_right(ui_container_selections,
					 LV_OBJ_PART_MAIN, LV_STATE_DEFAULT,
					 CONTAINER_PADDING);

	lv_chart_set_y_range(ui_chart, LV_CHART_AXIS_PRIMARY_Y,
			     CHART_Y_PRIMARY_MIN, CHART_Y_PRIMARY_MAX);
	lv_chart_set_y_range(ui_chart, LV_CHART_AXIS_SECONDARY_Y,
			     CHART_Y_SECONDARY_MIN, CHART_Y_SECONDARY_MAX);

	lv_obj_set_size(ui_chart, CHART_WIDTH, CHART_HEIGHT);
	lv_obj_align(ui_chart, NULL, LV_ALIGN_IN_TOP_MID, 0, 0);
	lv_chart_set_type(ui_chart, LV_CHART_TYPE_LINE);

	lv_chart_set_point_count(ui_chart, CHART_NUMBER_OF_POINTS);

	lv_chart_set_x_tick_texts(ui_chart, "old\nnew", 1,
				  LV_CHART_AXIS_DRAW_LAST_TICK);
	lv_chart_set_y_tick_texts(ui_chart, "100\n80\n60\n40\n20\n0\n-20", 1,
				  LV_CHART_AXIS_DRAW_LAST_TICK);

	lv_chart_set_secondary_y_tick_texts(ui_chart,
					    "1060\n1040\n1020\n1000\n980\n960",
					    1, LV_CHART_AXIS_DRAW_LAST_TICK);

	lv_obj_set_style_local_pad_top(ui_chart, LV_OBJ_PART_MAIN,
				       LV_STATE_DEFAULT, CHART_PADDING_TOP);
	lv_obj_set_style_local_pad_bottom(ui_chart, LV_OBJ_PART_MAIN,
					  LV_STATE_DEFAULT,
					  CHART_PADDING_BOTTOM);
	lv_obj_set_style_local_pad_left(ui_chart, LV_OBJ_PART_MAIN,
					LV_STATE_DEFAULT, CHART_PADDING_LEFT);
	lv_obj_set_style_local_pad_right(ui_chart, LV_OBJ_PART_MAIN,
					 LV_STATE_DEFAULT, CHART_PADDING_RIGHT);

	chart_series_temperature = lv_chart_add_series(ui_chart, LV_COLOR_RED);
	chart_series_humidity = lv_chart_add_series(ui_chart, LV_COLOR_YELLOW);
	chart_series_pressure = lv_chart_add_series(ui_chart, LV_COLOR_GREEN);
	chart_series_dew_point = lv_chart_add_series(ui_chart, LV_COLOR_BLUE);

	ui_check_temperature =
		lv_checkbox_create(ui_container_selections, NULL);
	lv_checkbox_set_checked(ui_check_temperature, true);
	lv_checkbox_set_text(ui_check_temperature, "Temp.");
	lv_obj_align(ui_check_temperature, NULL, LV_ALIGN_CENTER, 0, 0);
	lv_obj_set_event_cb(ui_check_temperature, checkbox_event_handler);
	lv_obj_set_style_local_bg_color(ui_check_temperature,
					LV_CHECKBOX_PART_BULLET,
					LV_STATE_CHECKED, LV_COLOR_RED);
	lv_obj_set_style_local_border_color(ui_check_temperature,
					    LV_CHECKBOX_PART_BULLET,
					    LV_STATE_DEFAULT, LV_COLOR_RED);

	ui_check_humidity = lv_checkbox_create(ui_container_selections, NULL);
	lv_checkbox_set_checked(ui_check_humidity, true);
	lv_checkbox_set_text(ui_check_humidity, "Hum.");
	lv_obj_align(ui_check_humidity, NULL, LV_ALIGN_CENTER, 0, 0);
	lv_obj_set_event_cb(ui_check_humidity, checkbox_event_handler);
	lv_obj_set_style_local_bg_color(ui_check_humidity,
					LV_CHECKBOX_PART_BULLET,
					LV_STATE_CHECKED, LV_COLOR_YELLOW);
	lv_obj_set_style_local_border_color(ui_check_humidity,
					    LV_CHECKBOX_PART_BULLET,
					    LV_STATE_DEFAULT, LV_COLOR_YELLOW);

	ui_check_pressure = lv_checkbox_create(ui_container_selections, NULL);
	lv_checkbox_set_checked(ui_check_pressure, true);
	lv_checkbox_set_text(ui_check_pressure, "Pres.");
	lv_obj_align(ui_check_pressure, NULL, LV_ALIGN_CENTER, 0, 0);
	lv_obj_set_event_cb(ui_check_pressure, checkbox_event_handler);
	lv_obj_set_style_local_bg_color(ui_check_pressure,
					LV_CHECKBOX_PART_BULLET,
					LV_STATE_CHECKED, LV_COLOR_GREEN);
	lv_obj_set_style_local_border_color(ui_check_pressure,
					    LV_CHECKBOX_PART_BULLET,
					    LV_STATE_DEFAULT, LV_COLOR_GREEN);

	ui_check_dew_point = lv_checkbox_create(ui_container_selections, NULL);
	lv_checkbox_set_checked(ui_check_dew_point, true);
	lv_checkbox_set_text(ui_check_dew_point, "Dew");
	lv_obj_align(ui_check_dew_point, NULL, LV_ALIGN_CENTER, 0, 0);
	lv_obj_set_event_cb(ui_check_dew_point, checkbox_event_handler);
	lv_obj_set_style_local_bg_color(ui_check_dew_point,
					LV_CHECKBOX_PART_BULLET,
					LV_STATE_CHECKED, LV_COLOR_BLUE);
	lv_obj_set_style_local_border_color(ui_check_dew_point,
					    LV_CHECKBOX_PART_BULLET,
					    LV_STATE_DEFAULT, LV_COLOR_BLUE);

	ui_button_clear = lv_btn_create(ui_container_main, NULL);
	lv_obj_align(ui_button_clear, NULL, LV_ALIGN_CENTER, 0, 0);
	lv_btn_set_fit(ui_button_clear, LV_FIT_TIGHT);
	lv_obj_set_event_cb(ui_button_clear, button_event_handler);
	ui_text_clear = lv_label_create(ui_button_clear, NULL);
	lv_label_set_text(ui_text_clear, "Clear");

	ui_text_status = lv_label_create(ui_container_main, NULL);

	lv_label_set_text(ui_text_status, display_string_buffer);
	lv_obj_align(ui_text_status, NULL, LV_ALIGN_CENTER, 0, 0);

	update_lcd_text();

	display_blanking_off(display_dev);
	lv_task_handler();

	k_timer_start(&ess_lcd_display_update_timer,
		      K_MSEC(DISPLAY_INPUT_PERIOD_MS),
		      K_MSEC(DISPLAY_INPUT_PERIOD_MS));
}

bool is_lcd_present(void)
{
	return lcd_present;
}

void update_lcd_graph(float temperature, float humidity, float pressure,
		      float dew_point)
{
	/* Move all the buffered data up by a position */
	memmove(chart_data_buffer_temperature,
		&chart_data_buffer_temperature[1],
		sizeof(chart_data_buffer_temperature) -
			sizeof(chart_data_buffer_temperature[0]));
	memmove(chart_data_buffer_humidity, &chart_data_buffer_temperature[1],
		sizeof(chart_data_buffer_humidity) -
			sizeof(chart_data_buffer_temperature[0]));
	memmove(chart_data_buffer_pressure, &chart_data_buffer_temperature[1],
		sizeof(chart_data_buffer_pressure) -
			sizeof(chart_data_buffer_temperature[0]));
	memmove(chart_data_buffer_dew_point, &chart_data_buffer_temperature[1],
		sizeof(chart_data_buffer_dew_point) -
			sizeof(chart_data_buffer_temperature[0]));

	/* Append the newest data to the end of the array */
	chart_data_buffer_temperature[CHART_NUMBER_OF_POINTS - 1] =
		(int16_t)temperature;
	chart_data_buffer_humidity[CHART_NUMBER_OF_POINTS - 1] =
		(int16_t)humidity;
	chart_data_buffer_pressure[CHART_NUMBER_OF_POINTS - 1] =
		(int16_t)((pressure / PRESSURE_TO_Y_AXIS_DIVISION) -
			  PRESSURE_TO_Y_AXIS_SUBTRACTION);
	chart_data_buffer_dew_point[CHART_NUMBER_OF_POINTS - 1] =
		(int16_t)dew_point;

	if (chart_readings < CHART_NUMBER_OF_POINTS) {
		++chart_readings;
	}

	/* Only add the data to the graph if the respective checkbox is 
	 * ticked
	 */
	if (lv_checkbox_is_checked(ui_check_temperature)) {
		lv_chart_set_next(
			ui_chart, chart_series_temperature,
			chart_data_buffer_temperature[CHART_NUMBER_OF_POINTS -
						      1]);
	}

	if (lv_checkbox_is_checked(ui_check_humidity)) {
		lv_chart_set_next(
			ui_chart, chart_series_humidity,
			chart_data_buffer_humidity[CHART_NUMBER_OF_POINTS - 1]);
	}

	if (lv_checkbox_is_checked(ui_check_pressure)) {
		lv_chart_set_next(
			ui_chart, chart_series_pressure,
			chart_data_buffer_pressure[CHART_NUMBER_OF_POINTS - 1]);
	}

	if (lv_checkbox_is_checked(ui_check_dew_point)) {
		lv_chart_set_next(
			ui_chart, chart_series_dew_point,
			chart_data_buffer_dew_point[CHART_NUMBER_OF_POINTS - 1]);
	}
}

void update_lcd_text(void)
{
	uint32_t uptime_seconds = (uint32_t)(k_uptime_get() / MS_PER_SECOND);

	if (remote_device_connected) {
		/* In a connection, output the uptime and the remote BLE address
		 * of the connected device
		 */
		sprintf(display_string_buffer,
			"Up %d seconds, connected\n"
			"Remote Address: %02x %02x%02x%02x%02x%02x%02x",
			uptime_seconds, remote_device_type,
			remote_device_address[BLE_ADDRESS_OUTPUT_A],
			remote_device_address[BLE_ADDRESS_OUTPUT_B],
			remote_device_address[BLE_ADDRESS_OUTPUT_C],
			remote_device_address[BLE_ADDRESS_OUTPUT_D],
			remote_device_address[BLE_ADDRESS_OUTPUT_E],
			remote_device_address[BLE_ADDRESS_OUTPUT_F]);
	} else {
		/* In advertising, output the uptime, the device name being
		 * advertised and the BLE address of the advert
		 */
		bt_addr_le_t ble_address_local;
		size_t ble_address_count = BLE_ADDRESS_COUNT;
		bt_id_get(&ble_address_local, &ble_address_count);
		sprintf(display_string_buffer,
			"Up %d seconds, advertising\n"
			"Name: %s\nAddress: %02x %02x%02x%02x%02x%02x%02x",
			uptime_seconds, bt_get_name(), ble_address_local.type,
			ble_address_local.a.val[BLE_ADDRESS_OUTPUT_A],
			ble_address_local.a.val[BLE_ADDRESS_OUTPUT_B],
			ble_address_local.a.val[BLE_ADDRESS_OUTPUT_C],
			ble_address_local.a.val[BLE_ADDRESS_OUTPUT_D],
			ble_address_local.a.val[BLE_ADDRESS_OUTPUT_E],
			ble_address_local.a.val[BLE_ADDRESS_OUTPUT_F]);
	}

	lv_label_set_text(ui_text_status, display_string_buffer);
}

void update_lcd_connected_address(bool connected, uint8_t type,
				  const uint8_t *address)
{
	/* Update the local buffer if there is a remote device connected and
	 * what the BLE address is
	 */
	remote_device_connected = connected;
	if (connected == true) {
		remote_device_type = type;
		memcpy(remote_device_address, address,
		       sizeof(remote_device_address));
	}

	update_lcd_text();
}

#endif
```

## src/sensor.c
```c
/**
 * @file sensor.c
 * @brief Handles dealing with and formatting data from the BME680 sensor
 *
 * Copyright (c) 2021 Laird Connectivity
 *
 * SPDX-License-Identifier: Apache-2.0
 */

/******************************************************************************/
/* Includes                                                                   */
/******************************************************************************/
#include <logging/log.h>
#include "sensor.h"

LOG_MODULE_REGISTER(sensor);

/******************************************************************************/
/* Local Constant, Macro and Type Definitions                                 */
/******************************************************************************/
#define TEMPERATURE_VAL1_MULTIPLIER 100
#define TEMPERATURE_VAL2_DIVIDER    10000
#define HUMIDITY_VAL1_MULTIPLIER    100
#define HUMIDITY_VAL2_DIVIDER       10000
#define PRESSURE_VAL1_MULTIPLIER    10000
#define PRESSURE_VAL2_DIVIDER       100
#define PRESSURE_VAL2_DIVIDER_DBG   1000
#define FLOAT_TEMPERATURE_DIVIDER   1000000
#define FLOAT_HUMIDITY_DIVIDER      1000000
#define FLOAT_PRESSURE_DIVIDER      1000
#define FLOAT_PRESSURE_MULTIPLIER   1000

#if defined(CONFIG_BOARD_BL5340_DVK_CPUAPP)
#define SENSOR_TYPE bosch_bme680
#elif defined(CONFIG_BOARD_PINNACLE_100_DVK)
#define SENSOR_TYPE bosch_bme680
#elif defined(CONFIG_BOARD_BL654_SENSOR_BOARD)
#define SENSOR_TYPE bosch_bme280
#else
#error "Unsupported board"
#endif

/******************************************************************************/
/* Local Data Definitions                                                     */
/******************************************************************************/
static struct sensor_value temperature_value, pressure_value, humidity_value;
static bool sensor_present = false;

/******************************************************************************/
/* Global Function Definitions                                                */
/******************************************************************************/
void setup_sensor(void)
{
	const struct device *dev =
		device_get_binding(DT_LABEL(DT_INST(0, SENSOR_TYPE)));
	if (dev == NULL) {
		sensor_present = false;
		LOG_ERR("Error! %s sensor was not found\n",
			DT_LABEL(DT_INST(0, SENSOR_TYPE)));
	} else {
		sensor_present = true;
	}

	LOG_DBG("Device %p name is %s\n", dev, dev->name);

	/* Clear initial sensor readings */
	temperature_value.val1 = 0;
	temperature_value.val2 = 0;
	pressure_value.val1 = 0;
	pressure_value.val2 = 0;
	humidity_value.val1 = 0;
	humidity_value.val2 = 0;
}

bool is_sensor_present(void)
{
	return sensor_present;
}

void read_sensor(void)
{
	if (sensor_present) {
		const struct device *dev =
			device_get_binding(DT_LABEL(DT_INST(0, SENSOR_TYPE)));
		sensor_sample_fetch(dev);
		sensor_channel_get(dev, SENSOR_CHAN_AMBIENT_TEMP,
				   &temperature_value);
		sensor_channel_get(dev, SENSOR_CHAN_PRESS, &pressure_value);
		sensor_channel_get(dev, SENSOR_CHAN_HUMIDITY, &humidity_value);

		LOG_DBG("T: %d.%02dC, H: %d.%02d%%, P: %d%03dPa\n",
			temperature_value.val1,
			temperature_value.val2 / TEMPERATURE_VAL2_DIVIDER,
			humidity_value.val1,
			humidity_value.val2 / HUMIDITY_VAL2_DIVIDER,
			pressure_value.val1,
			pressure_value.val2 / PRESSURE_VAL2_DIVIDER_DBG);
	}
}

int16_t read_temperature(void)
{
	return (temperature_value.val1 * TEMPERATURE_VAL1_MULTIPLIER) +
	       (temperature_value.val2 / TEMPERATURE_VAL2_DIVIDER);
}

int16_t read_humidity(void)
{
	return (humidity_value.val1 * HUMIDITY_VAL1_MULTIPLIER) +
	       (humidity_value.val2 / HUMIDITY_VAL2_DIVIDER);
}

int32_t read_pressure(void)
{
	return (pressure_value.val1 * PRESSURE_VAL1_MULTIPLIER) +
	       (pressure_value.val2 / PRESSURE_VAL2_DIVIDER);
}

void read_temperature_float(float *temperature)
{
	*temperature = temperature_value.val2;
	*temperature /= FLOAT_TEMPERATURE_DIVIDER;
	*temperature += temperature_value.val1;
}

void read_humidity_float(float *humidity)
{
	*humidity = humidity_value.val2;
	*humidity /= FLOAT_HUMIDITY_DIVIDER;
	*humidity += humidity_value.val1;
}

void read_pressure_float(float *pressure)
{
	*pressure = pressure_value.val2;
	*pressure /= FLOAT_PRESSURE_DIVIDER;
	*pressure += ((float)pressure_value.val1) * FLOAT_PRESSURE_MULTIPLIER;
}
```
